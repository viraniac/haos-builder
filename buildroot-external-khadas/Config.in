## buildroot-external-khadas/Config.in
```kconfig
source "$BR2_EXTERNAL_KHADAS_PATH/package/khadas-uboot/Config.in"
source "$BR2_EXTERNAL_KHADAS_PATH/package/khadas-firmware/Config.in"
source "$BR2_EXTERNAL_KHADAS_PATH/package/rockchip-rkbin-custom/Config.in"
source "$BR2_EXTERNAL_KHADAS_PATH/package/uboot-vendor/Config.in"
```

## buildroot-external-khadas/package/khadas-firmware/Config.in
```kconfig
config BR2_PACKAGE_KHADAS_FIRMWARE
	bool "Wireless firmware for Khadas Boards"
	help
	  Add firmware for wireless chipsets used on Khadas Boards.
```

## buildroot-external/Config.in
```kconfig
source "$BR2_EXTERNAL_SBC_PATH/package/khadas-uboot/Config.in"
source "$BR2_EXTERNAL_SBC_PATH/package/khadas-firmware/Config.in"
source "$BR2_EXTERNAL_SBC_PATH/package/rockchip-rkbin-custom/Config.in"
source "$BR2_EXTERNAL_SBC_PATH/package/uboot-vendor/Config.in"
source "$BR2_EXTERNAL_SBC_PATH/package/common-drivers/Config.in"
```

## buildroot-external/package/common-drivers/Config.in
```kconfig
# Automatically selected by the corresponding linux extension
config BR2_PACKAGE_COMMON_DRIVERS
	bool

if BR2_PACKAGE_COMMON_DRIVERS

choice
	prompt "Amlogic common drivers version"

config BR2_COMMON_DRIVERS_LATEST_VERSION
	bool "Latest version"

config BR2_COMMON_DRIVERS_CUSTOM_TARBALL
	bool "Custom tarball"
	help
	  This option allows to specify a URL pointing to a Amlogic
	  common drivers source tarball. This URL can use any protocol
	  recognized by Buildroot, like http://, ftp://, file:// or
	  scp://.

	  When pointing to a local tarball using file://, you may want
	  to use a make variable like $(TOPDIR) to reference the root of
	  the Buildroot tree.

config BR2_COMMON_DRIVERS_CUSTOM_GIT
	bool "Custom Git repository"
	help
	  This option allows Buildroot to get the Amlogic common drivers
	  source code from a Git repository.

endchoice

config BR2_COMMON_DRIVERS_CUSTOM_TARBALL_LOCATION
	string "URL of custom common drivers tarball"
	depends on BR2_COMMON_DRIVERS_CUSTOM_TARBALL

if BR2_COMMON_DRIVERS_CUSTOM_GIT

config BR2_COMMON_DRIVERS_CUSTOM_REPO_URL
	string "URL of custom repository"

config BR2_COMMON_DRIVERS_CUSTOM_REPO_VERSION
	string "Custom repository version"
	help
	  Revision to use in the typical format used by
	  Git/Mercurial/Subversion E.G. a sha id, a tag, branch, ..

endif

config BR2_PACKAGE_COMMON_DRIVERS_VERSION
	string
	default "khadas-vims-5.15.y" if BR2_COMMON_DRIVERS_LATEST_VERSION
	default "custom" if BR2_COMMON_DRIVERS_CUSTOM_TARBALL
	default BR2_COMMON_DRIVERS_CUSTOM_REPO_VERSION \
		if BR2_COMMON_DRIVERS_CUSTOM_GIT

endif
```

## buildroot-external/package/rockchip-rkbin-custom/Config.in
```kconfig
config BR2_PACKAGE_ROCKCHIP_RKBIN_CUSTOM
	bool "rockchip-rkbin-custom"
	depends on BR2_arm || BR2_aarch64
	help
	  This package provides Rockchip SoC binary blobs for U-Boot.

if BR2_PACKAGE_ROCKCHIP_RKBIN_CUSTOM

config BR2_PACKAGE_ROCKCHIP_RKBIN_CUSTOM_VERSION
	string "Rockchip rkbin version"
	default "b4558da0860ca48bf1a571dd33ccba580b9abe23"
	help
	  Git commit hash of Rockchip rkbin repository that should
	  should be used for the required files.

config BR2_PACKAGE_ROCKCHIP_RKBIN_CUSTOM_TPL_FILENAME
	string "Rockchip rkbin tpl file path"
	help
	  Path to the tpl file inside the rkbin repository. The
	  specified file will be copied and used by U-Boot as tpl.

config BR2_PACKAGE_ROCKCHIP_RKBIN_CUSTOM_BL31_FILENAME
	string "Rockchip rkbin bl31 file path"
	help
	  Path to the bl31 file inside the rkbin repository. The
	  specified file will be copied and used by U-Boot as bl31.

config BR2_PACKAGE_ROCKCHIP_RKBIN_CUSTOM_TEE_FILENAME
	string "Rockchip rkbin tee file path"
	help
	  Path to the TEE file inside the rkbin repository. The
	  specified file will be copied and used by U-Boot as TEE.

endif # BR2_PACKAGE_ROCKCHIP_RKBIN_CUSTOM
```
